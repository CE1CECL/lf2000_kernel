## drivers/net/wireless/Kconfig.rej
```kconfig
--- drivers/net/wireless/Kconfig	2012-12-17 13:38:05.000000000 -0500
+++ drivers/net/wireless/Kconfig	2013-10-23 15:30:06.000000000 -0400
@@ -268,9 +268,28 @@ config MWL8K
 	  To compile this driver as a module, choose M here: the module
 	  will be called mwl8k.  If unsure, say N.
 
+config BCM4319
+	bool "BCM4319 build support"
+	depends on MMC || SPI || USB
+	select WIRELESS_EXT
+	select WEXT_CORE
+	select WEXT_PROC
+	select WEXT_PRIV
+	---help---
+	  Kernel support for the bcm4319 driver, dhd-cdc-sdmmc-gpl. This is
+	  required for building the driver both in and out of tree.
+	  
+config ARCADYAN_BCM4319
+	tristate "Arcadyan BCM4319 Wifi Driver"
+	depends on MMC
+	select BCM4319
+	---help---
+	  This driver supports the BCM4319 based Arcadyan Wifi module.
+	
 source "drivers/net/wireless/ath/Kconfig"
 source "drivers/net/wireless/b43/Kconfig"
 source "drivers/net/wireless/b43legacy/Kconfig"
+source "drivers/net/wireless/bcmdhd/Kconfig"
 source "drivers/net/wireless/brcm80211/Kconfig"
 source "drivers/net/wireless/hostap/Kconfig"
 source "drivers/net/wireless/ipw2x00/Kconfig"
```
